# file: pachi_board.ioc
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Mcu.Family=STM32G0
Mcu.Name=STM32G031J(4-6)Mx
Mcu.Package=SO8N
PA12\ [PA10].Signal=GPIO_Output
PA13.Mode=Serial_Wire
PA13.Signal=SYS_SWDIO
PA14-BOOT0.Mode=Serial_Wire
PA14-BOOT0.Signal=SYS_SWCLK
ProjectManager.HeapSize=0x200
ProjectManager.StackSize=0x400
ProjectManager.TargetToolchain=STM32CubeIDE
RCC.ADCFreq_Value=40000000
RCC.AHBFreq_Value=40000000
RCC.CortexFreq_Value=40000000
RCC.EXTERNAL_CLOCK_VALUE=12288000
RCC.HCLKFreq_Value=40000000
RCC.HSE_VALUE=8000000
RCC.HSI_VALUE=16000000
RCC.LSE_VALUE=32768
RCC.PLLN=10
RCC.PLLR=RCC_PLLR_DIV4
RCC.SYSCLKFreq_VALUE=40000000
RCC.SYSCLKSource=RCC_SYSCLKSOURCE_PLLCLK
RCC.VCOOutputFreq_Value=160000000
VP_TIM1_VS_ClockSourceINT.Mode=Internal
board=custom

// file: Core/Src/main.c
/* USER CODE BEGIN Header */
/**
  ******************************************************************************
  * @file           : main.c
  * @brief          : Main program body
  ******************************************************************************
  * @attention
  *
  * <h2><center>&copy; Copyright (c) 2021 STMicroelectronics.
  * All rights reserved.</center></h2>
  *
  * This software component is licensed by ST under BSD 3-Clause license,
  * the "License"; You may not use this file except in compliance with the
  * License. You may obtain a copy of the License at:
  *                        opensource.org/licenses/BSD-3-Clause
  *
  ******************************************************************************
  */
/* USER CODE END Header */
#include "main.h"

TIM_HandleTypeDef htim1;

void SystemClock_Config(void);
static void MX_GPIO_Init(void);
static void MX_TIM1_Init(void);

/* USER CODE BEGIN 0 */
#define LED_NUM (13)

void delay_ns(uint16_t ns_count)
{

	//one clock takes 15.625 ns @64MHz
	//ex) t[ns]->  ns_count= t/15.625
	__HAL_TIM_SET_COUNTER(&htim1,0);  // set the counter value a 0 on
	while (__HAL_TIM_GET_COUNTER(&htim1) < ns_count){
		;  // wait for the counter to reach the us input in the parameter
	}
}

void HAL_GPIO_WritePin_wo_assert(GPIO_TypeDef *GPIOx, uint16_t GPIO_Pin, GPIO_PinState PinState)
{

  if (PinState != GPIO_PIN_RESET)
  {
    GPIOx->BSRR = (uint32_t)GPIO_Pin;
  }
  else
  {
    GPIOx->BRR = (uint32_t)GPIO_Pin;
  }
}

void On(){
	HAL_GPIO_WritePin_wo_assert(GPIOA, GPIO_PIN_12, GPIO_PIN_SET);
}
void Off(){
	HAL_GPIO_WritePin_wo_assert(GPIOA, GPIO_PIN_12, GPIO_PIN_RESET);
}
int a=10;
int b=30;
int count=0;
void code(int i){
	if(i==0){
		//On();
		__disable_irq();
	    GPIOA->BSRR = (uint32_t)GPIO_PIN_12;
	    //delay_ns(a); //300 ns
	    asm("nop");
	    asm("nop");
	    asm("nop");
	    asm("nop");
	    asm("nop");
	    asm("nop");
	    asm("nop");
	    asm("nop");

	    //Off();
	    GPIOA->BRR = (uint32_t)GPIO_PIN_12;
		//delay_ns(b);
	    asm("nop");
	    asm("nop");
	    asm("nop");
	    asm("nop");
	    asm("nop");
	    asm("nop");
	    asm("nop");
	    asm("nop");
	    asm("nop");
	    asm("nop");
	    asm("nop");
	    asm("nop");
	    asm("nop");

	    __enable_irq();

	}else if(i==1){
		//On();
		__disable_irq();
	    GPIOA->BSRR = (uint32_t)GPIO_PIN_12;
		//delay_ns(b);
	    asm("nop");
	    asm("nop");
	    asm("nop");
	    asm("nop");
	    asm("nop");
	    asm("nop");
	    asm("nop");
	    asm("nop");
	    asm("nop");
	    asm("nop");
	    asm("nop");
	    asm("nop");
	    asm("nop");
	    asm("nop");

	    asm("nop");
	    //Off();
	    GPIOA->BRR = (uint32_t)GPIO_PIN_12;
		//delay_ns(a);
	    asm("nop");
	    asm("nop");
	    asm("nop");
	    asm("nop");
	    asm("nop");
	    asm("nop");
	    asm("nop");
	    asm("nop");
	    asm("nop");
		__enable_irq();

	}else if(i==-1){
		//Off();
	    GPIOA->BRR = (uint32_t)GPIO_PIN_12;
	    //HAL_Delay(1);
	    for(int i=0;i<100;i++)delay_ns(6400);

	}else{
	    GPIOA->BRR = (uint32_t)GPIO_PIN_12;

	}
}

char RGB[LED_NUM][3];
void Show(){
	code(-1);

	for(int id=0;id<LED_NUM;id++){
		code((RGB[id][0]>>7)&1);
		code((RGB[id][0]>>6)&1);
		code((RGB[id][0]>>5)&1);
		code((RGB[id][0]>>4)&1);
		code((RGB[id][0]>>3)&1);
		code((RGB[id][0]>>2)&1);
		code((RGB[id][0]>>1)&1);
		code((RGB[id][0]>>0)&1);

		code((RGB[id][1]>>7)&1);
		code((RGB[id][1]>>6)&1);
		code((RGB[id][1]>>5)&1);
		code((RGB[id][1]>>4)&1);
		code((RGB[id][1]>>3)&1);
		code((RGB[id][1]>>2)&1);
		code((RGB[id][1]>>1)&1);
		code((RGB[id][1]>>0)&1);

		code((RGB[id][2]>>7)&1);
		code((RGB[id][2]>>6)&1);
		code((RGB[id][2]>>5)&1);
		code((RGB[id][2]>>4)&1);
		code((RGB[id][2]>>3)&1);
		code((RGB[id][2]>>2)&1);
		code((RGB[id][2]>>1)&1);
		code((RGB[id][2]>>0)&1);

	}
	//code(-1);

}
/* USER CODE END 0 */

int main(void)
{

  /* MCU Configuration--------------------------------------------------------*/

  /* Reset of all peripherals, Initializes the Flash interface and the Systick. */
  HAL_Init();

  /* Configure the system clock */
  SystemClock_Config();

  /* Initialize all configured peripherals */
  MX_GPIO_Init();
  MX_TIM1_Init();
  /* USER CODE BEGIN 2 */
  HAL_TIM_Base_Start(&htim1);
  //while(1){}
  Off();
  code(-1);
  for(int id=0;id<LED_NUM;id++){
	  RGB[id][0]=0;
	  RGB[id][1]=0;
	  RGB[id][2]=0;
  }
  Show();

  /* USER CODE END 2 */

  /* Infinite loop */
  while (1)
  {

    /* USER CODE BEGIN 3 */
	  int t=0;
	  int tt=0;
	  while(1){

		  for(int id=0;id<LED_NUM;id+=1){
//			  for(int i=0;i<LED_NUM;i++){
//				  RGB[i][0]=0;
//				  RGB[i][1]=0;
//				  RGB[i][2]=0;

				  if(t<100){
					  RGB[id][0]=t /1.0;
					  RGB[id][1]=(100-t) /1.0;
					  RGB[id][2]=0;
				  }else if(t<200){
					  RGB[id][0]=(100-(t-100) ) /1.0;
					  RGB[id][1]=0;
					  RGB[id][2]=(t-100)/1.0;
				  }else if(t<300){
					  RGB[id][0]=0;
					  RGB[id][1]=(t-200)/1.0;
					  RGB[id][2]=(100-(t-200))/1.0;
				  }else{
					  t=0;
				  }

			  }
			  Show();

			  //HAL_Delay(1);
			  //Delay(1000);

		  //HAL_Delay(50);

		  tt++;
		  if(tt>1){
			  tt=0;
			  t+=1;
		  }

	  }
	  for(int r=50;r<100;r+=5){
		  for(int id=0;id<LED_NUM;id++){
			  for(int i=0;i<LED_NUM;i++){
				  RGB[i][0]=0;
				  RGB[i][1]=0;
				  RGB[i][2]=0;
			  }
			  RGB[id][0]=r;
			  RGB[id][1]=r;
			  RGB[id][2]=0;
			  Show();
			  //HAL_Delay(1);
		  }
	  }
	  for(int r=50;r<100;r+=5){
		  for(int id=0;id<LED_NUM;id++){
			  for(int i=0;i<LED_NUM;i++){
				  RGB[i][0]=0;
				  RGB[i][1]=0;
				  RGB[i][2]=0;
			  }
			  RGB[id][0]=r;
			  RGB[id][1]=0;
			  RGB[id][2]=r;
			  Show();
			  //HAL_Delay(1);
		  }
	  }
	  //HAL_GPIO_TogglePin(GPIOA, GPIO_PIN_12);
  }
  /* USER CODE END 3 */
}

void SystemClock_Config(void)
{
  RCC_OscInitTypeDef RCC_OscInitStruct = {0};
  RCC_ClkInitTypeDef RCC_ClkInitStruct = {0};
  RCC_PeriphCLKInitTypeDef PeriphClkInit = {0};

  /** Configure the main internal regulator output voltage
  */
  HAL_PWREx_ControlVoltageScaling(PWR_REGULATOR_VOLTAGE_SCALE1);
  /** Initializes the RCC Oscillators according to the specified parameters
  * in the RCC_OscInitTypeDef structure.
  */
  RCC_OscInitStruct.OscillatorType = RCC_OSCILLATORTYPE_HSI;
  RCC_OscInitStruct.HSIState = RCC_HSI_ON;
  RCC_OscInitStruct.HSIDiv = RCC_HSI_DIV1;
  RCC_OscInitStruct.HSICalibrationValue = RCC_HSICALIBRATION_DEFAULT;
  RCC_OscInitStruct.PLL.PLLState = RCC_PLL_ON;
  RCC_OscInitStruct.PLL.PLLSource = RCC_PLLSOURCE_HSI;
  RCC_OscInitStruct.PLL.PLLM = RCC_PLLM_DIV1;
  RCC_OscInitStruct.PLL.PLLN = 10;
  RCC_OscInitStruct.PLL.PLLP = RCC_PLLP_DIV2;
  RCC_OscInitStruct.PLL.PLLQ = RCC_PLLQ_DIV2;
  RCC_OscInitStruct.PLL.PLLR = RCC_PLLR_DIV4;
  if (HAL_RCC_OscConfig(&RCC_OscInitStruct) != HAL_OK)
  {
    Error_Handler();
  }
  /** Initializes the CPU, AHB and APB buses clocks
  */
  RCC_ClkInitStruct.ClockType = RCC_CLOCKTYPE_HCLK|RCC_CLOCKTYPE_SYSCLK
                              |RCC_CLOCKTYPE_PCLK1;
  RCC_ClkInitStruct.SYSCLKSource = RCC_SYSCLKSOURCE_PLLCLK;
  RCC_ClkInitStruct.AHBCLKDivider = RCC_SYSCLK_DIV1;
  RCC_ClkInitStruct.APB1CLKDivider = RCC_HCLK_DIV1;

  if (HAL_RCC_ClockConfig(&RCC_ClkInitStruct, FLASH_LATENCY_1) != HAL_OK)
  {
    Error_Handler();
  }
  /** Initializes the peripherals clocks
  */
  PeriphClkInit.PeriphClockSelection = RCC_PERIPHCLK_TIM1;
  PeriphClkInit.Tim1ClockSelection = RCC_TIM1CLKSOURCE_PCLK1;
  if (HAL_RCCEx_PeriphCLKConfig(&PeriphClkInit) != HAL_OK)
  {
    Error_Handler();
  }
}

static void MX_TIM1_Init(void)
{

  TIM_ClockConfigTypeDef sClockSourceConfig = {0};
  TIM_MasterConfigTypeDef sMasterConfig = {0};

  htim1.Instance = TIM1;
  htim1.Init.Prescaler = 0;
  htim1.Init.CounterMode = TIM_COUNTERMODE_UP;
  htim1.Init.Period = 65535;
  htim1.Init.ClockDivision = TIM_CLOCKDIVISION_DIV1;
  htim1.Init.RepetitionCounter = 0;
  htim1.Init.AutoReloadPreload = TIM_AUTORELOAD_PRELOAD_DISABLE;
  if (HAL_TIM_Base_Init(&htim1) != HAL_OK)
  {
    Error_Handler();
  }
  sClockSourceConfig.ClockSource = TIM_CLOCKSOURCE_INTERNAL;
  if (HAL_TIM_ConfigClockSource(&htim1, &sClockSourceConfig) != HAL_OK)
  {
    Error_Handler();
  }
  sMasterConfig.MasterOutputTrigger = TIM_TRGO_RESET;
  sMasterConfig.MasterOutputTrigger2 = TIM_TRGO2_RESET;
  sMasterConfig.MasterSlaveMode = TIM_MASTERSLAVEMODE_DISABLE;
  if (HAL_TIMEx_MasterConfigSynchronization(&htim1, &sMasterConfig) != HAL_OK)
  {
    Error_Handler();
  }

}

static void MX_GPIO_Init(void)
{
  GPIO_InitTypeDef GPIO_InitStruct = {0};

  /* GPIO Ports Clock Enable */
  __HAL_RCC_GPIOA_CLK_ENABLE();

  /*Configure GPIO pin Output Level */
  HAL_GPIO_WritePin(GPIOA, GPIO_PIN_12, GPIO_PIN_RESET);

  /*Configure GPIO pin : PA12 */
  GPIO_InitStruct.Pin = GPIO_PIN_12;
  GPIO_InitStruct.Mode = GPIO_MODE_OUTPUT_PP;
  GPIO_InitStruct.Pull = GPIO_NOPULL;
  GPIO_InitStruct.Speed = GPIO_SPEED_FREQ_LOW;
  HAL_GPIO_Init(GPIOA, &GPIO_InitStruct);

}

void Error_Handler(void)
{
  __disable_irq();
  while (1)
  {
  }
}

/************************ (C) COPYRIGHT STMicroelectronics *****END OF FILE****/
